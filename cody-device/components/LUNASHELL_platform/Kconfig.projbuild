## main/Kconfig.projbuild
```kconfig
menu "ESP32 Luna Shell build profiles"

choice LUNASHELL_BUILD_MODE
    prompt "Firmware build mode"
    default LUNASHELL_BUILD_MODE_DEBUG
    help
        Build mode is independent of the hardware profile. The public wrapper
        defaults to Debug; Release requires an explicit -BuildMode Release.
        The wrapper rejects a generated configuration from another mode.

config LUNASHELL_BUILD_MODE_DEBUG
    bool "Debug: diagnostic logging and USB-friendly awake policy"

config LUNASHELL_BUILD_MODE_RELEASE
    bool "Release: warnings/errors and automatic Light-sleep"

endchoice

config LUNASHELL_BUILD_PROFILE_SCHEMA_VERSION
    int
    range 1 1
    default 1

choice LUNASHELL_BUILD_BOARD_PROFILE
    prompt "ESP32 Luna Shell board profile"
    default LUNASHELL_BUILD_BOARD_PROFILE_WAVESHARE_ESP32S3_TOUCH_AMOLED_1_75

config LUNASHELL_BUILD_BOARD_PROFILE_WAVESHARE_ESP32S3_TOUCH_AMOLED_1_75
    bool "Waveshare ESP32-S3 Touch AMOLED 1.75"

endchoice

choice LUNASHELL_BUILD_PROFILE
    prompt "ESP32 Luna Shell firmware profile"
    default LUNASHELL_BUILD_PROFILE_CODY_COMPANION
    help
        Select one cumulative product image. Headless keeps only the portable
        runtime foundation; Display and touch exposes those physical devices
        without a GUI; UI minimal adds the local display experience;
        Connected adds the network/provisioning stack; Full adds every standard
        Waveshare sensor, codec, and removable-storage service.

config LUNASHELL_BUILD_PROFILE_FULL
    bool "Full Waveshare device runtime"

config LUNASHELL_BUILD_PROFILE_HEADLESS
    bool "Headless runtime"

config LUNASHELL_BUILD_PROFILE_UI_MINIMAL
    bool "Display and touch shell only"

config LUNASHELL_BUILD_PROFILE_DISPLAY_TOUCH
    bool "Display and touch hardware without the Luna UI"

config LUNASHELL_BUILD_PROFILE_CODY_COMPANION
    bool "Cody connected companion without the Luna UI"
    help
        Keeps mandatory display, touch, Wi-Fi and BLE, with the small Cody 2D
        consumer. Excludes the Luna GUI and GNSS. This base does not implement
        OOBE, a Codex transport, or voice interaction yet.

config LUNASHELL_BUILD_PROFILE_CONNECTED
    bool "Connected UI runtime"

config LUNASHELL_BUILD_PROFILE_LEG_EDITION
    bool "Offline Leg Edition movement companion"

endchoice

menu "ESP32 Luna Shell board hardware drivers"

config LUNASHELL_CODY_RENDER_PEARL_JELLY
    bool "Render Cody with the pearlescent jelly sprite"
    depends on LUNASHELL_BUILD_PROFILE_CODY_COMPANION
    default y
    help
        Select the approved pearlescent texture and lobe-bound scanline morph.
        Enabled by default for the current artwork iteration. Disable to use
        the vector body and omit the jelly texture and row caches from firmware.
        The jelly mode targets 25 FPS; the vector mode keeps its 33 ms period.

config LUNASHELL_CODY_FACE_FOLLOWS_BODY
    bool "Deform Cody's face with the pearl-jelly body by default"
    depends on LUNASHELL_CODY_RENDER_PEARL_JELLY
    default y
    help
        Apply the body's forward scanline mapping to facial paths and touch
        points. CODY_companion_set_face_deformation changes this preference
        at runtime without restarting the renderer. The runtime flag is not
        persisted; this setting supplies the initial choice on each boot.

config LUNASHELL_CODY_FORCE_FIRST_BOOT
    bool "Force Cody first-boot greeting for development"
    depends on LUNASHELL_BUILD_PROFILE_CODY_COMPANION
    default y
    help
        Keep the effective first-boot setting at one during the current
        onboarding iteration. Still read and validate the real persisted
        setting; never overwrite a user's stored zero or hide an NVS failure.
        Disable to honor the persisted cody_firstboot preference alone.

config LUNA_SHELL_CODY_ENABLE_CODEX
    bool "Include Cody's Codex connection step"
    depends on LUNASHELL_BUILD_PROFILE_CODY_COMPANION
    default y
    help
        Include Cody's CCP1 display-code commissioning and authenticated local
        PC liveness route. Screen 12 publishes no success until the matching
        plugin confirms the code; screens 14/15 use retained PC identity rather
        than promoting Wi-Fi presence alone.

config LUNASHELL_CODY_DIAGNOSTICS_READOUT
    bool "Show Cody measured FPS and CPU readout at startup"
    depends on LUNASHELL_BUILD_PROFILE_CODY_COMPANION
    default y
    help
        Initial session preference for the existing measured diagnostic layer.
        Scene authoring also selects whether that scene admits the readout.
        Change it later with CODY_companion_set_debug_readout_enabled without
        rebuilding, allocating a framebuffer or altering sensor acquisition.

config LUNASHELL_CODY_START_AUTO_ROTATION
    bool "Enable shared display auto-rotation when Cody starts"
    depends on LUNASHELL_BUILD_PROFILE_CODY_COMPANION && LUNASHELL_BUILD_ENABLE_IMU
    default y
    help
        Explicitly enable and persist Luna's existing cardinal auto-rotation
        preference after strict saved-setting restoration. Already-enabled
        settings are not rewritten. Disable this startup policy to honor a
        saved off preference. Runtime settings still use the same Luna API.
        No Cody sensor-read loop or separate display/touch mapping is added.

choice LUNASHELL_BUILD_DISPLAY_DRIVER
    prompt "Display and touch board driver"
    default LUNASHELL_BUILD_DISPLAY_DRIVER_WAVESHARE_AMOLED
    help
        Select the physical display and touch implementation. The current
        Waveshare BSP owns both paths as one board-level driver.

config LUNASHELL_BUILD_DISPLAY_DRIVER_WAVESHARE_AMOLED
    bool "Waveshare 1.75 inch AMOLED with CST9217 touch"

config LUNASHELL_BUILD_DISPLAY_DRIVER_NONE
    bool "No display or touch hardware"

endchoice

choice LUNASHELL_BUILD_AUDIO_DRIVER
    prompt "Audio codec board driver"
    default LUNASHELL_BUILD_AUDIO_DRIVER_WAVESHARE_ES8311_ES7210
    help
        Select the board-owned audio transport. Input and output codecs are
        selected separately below so a product can include only a microphone,
        only a speaker, or a different future codec adapter.

config LUNASHELL_BUILD_AUDIO_DRIVER_WAVESHARE_ES8311_ES7210
    bool "Waveshare ES8311 speaker and ES7210 microphones"

config LUNASHELL_BUILD_AUDIO_DRIVER_NONE
    bool "No audio codec hardware"

endchoice

choice LUNASHELL_BUILD_AUDIO_OUTPUT_DRIVER
    prompt "Audio output codec"
    depends on LUNASHELL_BUILD_AUDIO_DRIVER_WAVESHARE_ES8311_ES7210
    default LUNASHELL_BUILD_AUDIO_OUTPUT_DRIVER_ES8311

config LUNASHELL_BUILD_AUDIO_OUTPUT_DRIVER_ES8311
    bool "ES8311 speaker codec"

config LUNASHELL_BUILD_AUDIO_OUTPUT_DRIVER_NONE
    bool "No speaker output hardware"

endchoice

choice LUNASHELL_BUILD_AUDIO_INPUT_DRIVER
    prompt "Audio input codec and microphone topology"
    depends on LUNASHELL_BUILD_AUDIO_DRIVER_WAVESHARE_ES8311_ES7210
    default LUNASHELL_BUILD_AUDIO_INPUT_DRIVER_ES7210_DUAL
    help
        Choose the physically populated microphone path. The mono ES7210
        option captures its first channel only; future codec adapters belong
        in this mutually exclusive choice.

config LUNASHELL_BUILD_AUDIO_INPUT_DRIVER_ES7210_DUAL
    bool "ES7210 dual microphones"

config LUNASHELL_BUILD_AUDIO_INPUT_DRIVER_ES7210_MONO
    bool "ES7210 single microphone"

config LUNASHELL_BUILD_AUDIO_INPUT_DRIVER_NONE
    bool "No microphone input hardware"

endchoice

choice LUNASHELL_BUILD_PMU_DRIVER
    prompt "PMU board driver"
    default LUNASHELL_BUILD_PMU_DRIVER_AXP2101

config LUNASHELL_BUILD_PMU_DRIVER_AXP2101
    bool "AXP2101 PMU"

config LUNASHELL_BUILD_PMU_DRIVER_NONE
    bool "No PMU hardware"

endchoice

choice LUNASHELL_BUILD_RTC_DRIVER
    prompt "RTC board driver"
    default LUNASHELL_BUILD_RTC_DRIVER_PCF85063

config LUNASHELL_BUILD_RTC_DRIVER_PCF85063
    bool "PCF85063 RTC"

config LUNASHELL_BUILD_RTC_DRIVER_NONE
    bool "No RTC hardware"

endchoice

choice LUNASHELL_BUILD_IMU_DRIVER
    prompt "IMU board driver"
    default LUNASHELL_BUILD_IMU_DRIVER_QMI8658
    help
        Choose one physical IMU driver. A selected driver reports its actual
        initialization error when the expected hardware is missing; it never
        probes unrelated chips as a fallback.

config LUNASHELL_BUILD_IMU_DRIVER_QMI8658
    bool "QMI8658 IMU"

config LUNASHELL_BUILD_IMU_DRIVER_NONE
    bool "No IMU hardware"

endchoice

choice LUNASHELL_BUILD_GNSS_DRIVER
    prompt "GNSS board driver"
    default LUNASHELL_BUILD_GNSS_DRIVER_LC76G

config LUNASHELL_BUILD_GNSS_DRIVER_LC76G
    bool "LC76G GNSS"

config LUNASHELL_BUILD_GNSS_DRIVER_NONE
    bool "No GNSS hardware"

endchoice

config LUNASHELL_BUILD_ENABLE_DISTANCE
    bool "Include external precision distance support"
    default n
    help
        Builds the calibrated distance service, its selected physical driver,
        and the matching device UI. Leave this disabled for the standard
        firmware image.

choice LUNASHELL_BUILD_DISTANCE_DRIVER
    prompt "External precision distance driver"
    depends on LUNASHELL_BUILD_ENABLE_DISTANCE
    default LUNASHELL_BUILD_DISTANCE_DRIVER_TOF400F_DUAL_UART
    help
        Select the distance hardware attached to the external GPIO16/17/18
        header. UART0 remains reserved for console diagnostics.

config LUNASHELL_BUILD_DISTANCE_DRIVER_TOF400F_DUAL_UART
    bool "Two TOF400F modules on shared TX and independent RX lines"

config LUNASHELL_BUILD_DISTANCE_DRIVER_NONE
    bool "No external distance driver"
    help
        Keeps the distance service stub and omits the distance UI even though
        the enclosing feature switch is enabled.

endchoice

endmenu

config LUNASHELL_BUILD_ENABLE_DISPLAY
    bool "Enable the physical AMOLED display"
    depends on LUNASHELL_BUILD_DISPLAY_DRIVER_WAVESHARE_AMOLED
    default n if LUNASHELL_BUILD_PROFILE_HEADLESS
    default y
    help
        Includes the CO5300 hardware owner independently of any GUI library.
        Display startup is critical whenever this hardware is selected.

config LUNASHELL_BUILD_ENABLE_TOUCH
    bool "Enable the physical CST9217 touch controller"
    depends on LUNASHELL_BUILD_ENABLE_DISPLAY
    default y
    help
        Includes the touch controller independently of the Luna UI. Coordinates
        use the same logical orientation as the display.

config LUNASHELL_BUILD_ENABLE_UI
    bool "Enable the Luna Brookesia/LVGL UI"
    depends on LUNASHELL_BUILD_ENABLE_DISPLAY && LUNASHELL_BUILD_ENABLE_TOUCH
    default y if LUNASHELL_BUILD_PROFILE_FULL || LUNASHELL_BUILD_PROFILE_CONNECTED || LUNASHELL_BUILD_PROFILE_UI_MINIMAL || LUNASHELL_BUILD_PROFILE_LEG_EDITION
    default n if LUNASHELL_BUILD_PROFILE_HEADLESS
    help
        Builds the Luna application and Brookesia 0.8 declarative GUI with its
        LVGL backend. Display and touch remain independently selected hardware
        when this UI is disabled.

config LUNASHELL_BUILD_ENABLE_BOOT_UI
    bool "Enable boot splash screen"
    depends on LUNASHELL_BUILD_ENABLE_UI
    default n if LUNASHELL_BUILD_PROFILE_UI_MINIMAL
    default y

config LUNASHELL_BUILD_ENABLE_AUDIO
    bool "Enable selected speaker and microphone paths"
    depends on LUNASHELL_BUILD_AUDIO_DRIVER_WAVESHARE_ES8311_ES7210
    default y if LUNASHELL_BUILD_PROFILE_FULL || LUNASHELL_BUILD_PROFILE_LEG_EDITION
    default n

# Capabilities describe the enabled adapter, never a product or board name.
# Future input adapters must opt in only after implementing 16 kHz PCM16 capture.
config LUNASHELL_BUILD_VOICE_MICROPHONE_CHANNELS
    int
    default 2 if LUNASHELL_BUILD_AUDIO_INPUT_DRIVER_ES7210_DUAL
    default 1 if LUNASHELL_BUILD_AUDIO_INPUT_DRIVER_ES7210_MONO
    default 0

config LUNASHELL_BUILD_VOICE_CAPTURE_AVAILABLE
    bool
    default y if LUNASHELL_BUILD_ENABLE_AUDIO && CODEC_ES7210_SUPPORT && (LUNASHELL_BUILD_AUDIO_INPUT_DRIVER_ES7210_DUAL || LUNASHELL_BUILD_AUDIO_INPUT_DRIVER_ES7210_MONO)

config LUNASHELL_BUILD_VOICE_ENGINE_AVAILABLE
    bool
    default y if IDF_TARGET_ESP32S3 && SPIRAM

config LUNASHELL_BUILD_ENABLE_VOICE_AFE
    bool "Enable ESP-SR 16 kHz voice AFE"
    depends on LUNASHELL_BUILD_VOICE_CAPTURE_AVAILABLE && LUNASHELL_BUILD_VOICE_ENGINE_AVAILABLE
    default n
    help
        Starts a dedicated 16 kHz PCM16 voice pipeline. It uses M/MM without
        a speaker or MR/MMNR with the enabled speaker PCM reference for AEC. This is the speech-recognition profile, not a
        full-duplex conversation path.

config LUNASHELL_BUILD_ENABLE_WAKE_WORD
    bool "Enable local wake-on-word"
    depends on LUNASHELL_BUILD_VOICE_CAPTURE_AVAILABLE && LUNASHELL_BUILD_VOICE_ENGINE_AVAILABLE
    select LUNASHELL_BUILD_ENABLE_VOICE_AFE
    default n
    help
        Loads the selected model from the internal model partition. No network
        or speech transcription is involved. Requires an enabled microphone
        adapter, a supported processor and PSRAM. Use a wake-word build variant.

choice LUNASHELL_BUILD_WAKE_WORD_MODEL
    prompt "Wake word model"
    depends on LUNASHELL_BUILD_ENABLE_WAKE_WORD
    default LUNASHELL_BUILD_WAKE_WORD_SOPHIA

config LUNASHELL_BUILD_WAKE_WORD_SOPHIA
    bool "Sophia (wn9_sophia_tts_v1)"

endchoice

config LUNASHELL_BUILD_WAKE_WORD_STANDBY_LISTENING
    bool "Keep listening during software standby"
    depends on LUNASHELL_BUILD_ENABLE_WAKE_WORD && LUNASHELL_BUILD_ENABLE_POWER_INPUTS
    default y
    help
        Keeps the CPU, audio capture and AFE active while the screen is off.
        This is software standby, not light/deep sleep. Explicit diagnostic
        and performance suspensions still pause recognition.

choice LUNASHELL_BUILD_VOICE_AFE_SR_PROFILE
    prompt "Voice AFE speech-recognition profile"
    depends on LUNASHELL_BUILD_ENABLE_VOICE_AFE
    default LUNASHELL_BUILD_VOICE_AFE_SR_PROFILE_LOW_COST

config LUNASHELL_BUILD_VOICE_AFE_SR_PROFILE_LOW_COST
    bool "AEC SR low cost"

config LUNASHELL_BUILD_VOICE_AFE_SR_PROFILE_HIGH_PERF
    bool "AEC SR high performance"

endchoice

config LUNASHELL_BUILD_ENABLE_BOOT_AUDIO
    bool "Enable boot sound effect"
    depends on LUNASHELL_BUILD_ENABLE_AUDIO
    depends on LUNASHELL_BUILD_AUDIO_OUTPUT_DRIVER_ES8311
    default y if LUNASHELL_BUILD_PROFILE_FULL
    default n

config LUNASHELL_BUILD_ENABLE_WIFI
    bool "Enable Wi-Fi station stack"
    default y if LUNASHELL_BUILD_PROFILE_FULL || LUNASHELL_BUILD_PROFILE_CONNECTED
    default n

config LUNASHELL_BUILD_ENABLE_BLUETOOTH
    bool "Enable Bluetooth telemetry stack"
    default y if LUNASHELL_BUILD_PROFILE_FULL || LUNASHELL_BUILD_PROFILE_CONNECTED
    default n

config LUNASHELL_BUILD_ENABLE_PROVISIONING
    bool "Enable Bluetooth Wi-Fi pairing flow"
    select LUNASHELL_BUILD_ENABLE_WIFI
    select LUNASHELL_BUILD_ENABLE_BLUETOOTH
    default y if LUNASHELL_BUILD_PROFILE_FULL || LUNASHELL_BUILD_PROFILE_CONNECTED
    default n
    help
        Keeps the BLE transport used by the secure Wi-Fi provisioning flow.

config LUNASHELL_BUILD_ENABLE_IMU
    bool "Enable IMU motion pipeline"
    depends on LUNASHELL_BUILD_IMU_DRIVER_QMI8658
    default y if LUNASHELL_BUILD_PROFILE_FULL || LUNASHELL_BUILD_PROFILE_LEG_EDITION
    default n

config LUNASHELL_BUILD_ENABLE_POWER_INPUTS
    bool "Enable button and power-management pipeline"
    depends on LUNASHELL_BUILD_PMU_DRIVER_AXP2101
    default y if LUNASHELL_BUILD_PROFILE_FULL || LUNASHELL_BUILD_PROFILE_LEG_EDITION
    default n

config LUNASHELL_BUILD_ENABLE_BATTERY
    bool "Enable AXP2101 battery measurements and telemetry"
    depends on LUNASHELL_BUILD_ENABLE_POWER_INPUTS
    default y if LUNASHELL_BUILD_PROFILE_FULL || LUNASHELL_BUILD_PROFILE_LEG_EDITION
    default n

config LUNASHELL_BUILD_ENABLE_RTC
    bool "Enable RTC time pipeline"
    depends on LUNASHELL_BUILD_RTC_DRIVER_PCF85063
    default y if LUNASHELL_BUILD_PROFILE_FULL
    default n

config LUNASHELL_BUILD_ENABLE_GNSS
    bool "Enable GNSS position pipeline"
    depends on LUNASHELL_BUILD_GNSS_DRIVER_LC76G
    default y if LUNASHELL_BUILD_PROFILE_FULL
    default n

config LUNASHELL_BUILD_ENABLE_REMOVABLE_STORAGE
    bool "Enable removable SD storage"
    default y if LUNASHELL_BUILD_PROFILE_FULL || LUNASHELL_BUILD_PROFILE_LEG_EDITION
    default n
    help
        Builds the SDMMC/FatFs owner and its guarded formatting workflow. This
        never changes the independent internal LittleFS/NVS ownership.

config LUNASHELL_BUILD_ENABLE_HTTP_API
    bool "Enable read-only HTTP diagnostics API"
    depends on LUNASHELL_BUILD_ENABLE_WIFI
    default y if LUNASHELL_BUILD_PROFILE_FULL || LUNASHELL_BUILD_PROFILE_CONNECTED
    default n

endmenu
```
